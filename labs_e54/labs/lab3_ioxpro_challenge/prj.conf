## CMakeLists.txt
```
# SPDX-License-Identifier: Apache-2.0

cmake_minimum_required(VERSION 3.20.0)
find_package(Zephyr REQUIRED HINTS $ENV{ZEPHYR_BASE})
project(blinky)

target_sources(app PRIVATE src/main.c src/producer.c src/consumer.c)
target_include_directories(app PRIVATE src)
```

## prj.conf
```kconfig
CONFIG_GPIO=y
CONFIG_I2C=y
CONFIG_SENSOR=y
CONFIG_LM75=y
```

## src/main.c
```c
/*
 * Copyright (c) 2016 Intel Corporation
 *
 * SPDX-License-Identifier: Apache-2.0
 */

#include <stdio.h>
#include <zephyr/kernel.h>
#include <zephyr/drivers/gpio.h>
#include "producer.h"
#include "consumer.h"

/* The devicetree node identifier for the "led0" alias. */
#define LED0_NODE DT_ALIAS(led0)


/*
 * Zephyr Thread defines
*/
#define STACKSIZE 1024
#define PRIORITY 7
K_THREAD_STACK_DEFINE(producerThreadstack_area, STACKSIZE);
struct k_thread producerThread_data;
K_THREAD_STACK_DEFINE(consumerThreadstack_area, STACKSIZE);
struct k_thread consumerThread_data;


/*
 * A build error on this line means your board is unsupported.
 * See the sample documentation for information on how to fix this.
 */
static const struct gpio_dt_spec led = GPIO_DT_SPEC_GET(LED0_NODE, gpios);

struct k_msgq consumerQueue;
char taskCommsBuffer[4 * sizeof(uint32_t)];

int main(void)
{
	int ret;

	if (!gpio_is_ready_dt(&led)) {
		return 0;
	}

	ret = gpio_pin_configure_dt(&led, GPIO_OUTPUT_ACTIVE);
	if (ret < 0) {
		return 0;
	}

	k_msgq_init(&consumerQueue, taskCommsBuffer, sizeof(uint32_t), 4);

	k_tid_t producer_tid = k_thread_create(&producerThread_data,
                         producerThreadstack_area,
                         K_THREAD_STACK_SIZEOF(producerThreadstack_area),
                         producerThread,
                         (void*)&led, (void*)&consumerQueue, (void*)NULL,
                         PRIORITY, 0, K_NO_WAIT);

	k_tid_t consumer_tid = k_thread_create(&consumerThread_data,
                          consumerThreadstack_area,
                          K_THREAD_STACK_SIZEOF(consumerThreadstack_area),
                          consumerThread,
                          (void*)NULL, (void*)&consumerQueue, (void*)NULL,
                          PRIORITY, 0, K_NO_WAIT);

	k_thread_name_set(producer_tid, (const char *)"producer");
	k_thread_name_set(consumer_tid, (const char *)"consumer");

	while (1) {
		k_msleep(SLEEP_TIME_MS);
	}
	return 0;
}
```

## src/consumer.c
```c
#include <zephyr/kernel.h>
#include "consumer.h"

void consumerThread(void*, void*inMsgQueue, void*){
	struct k_msgq *notifyMsgQueue = (struct k_msgq*)inMsgQueue;
	int32_t data = 0;

	while (1) {
        k_msgq_get(notifyMsgQueue, &data, K_FOREVER);
		printk("(consumer) Temperature: %d.%03d C\n", data / 1000, data % 1000);
	}
}
```

## src/producer.c
```c
#include <zephyr/kernel.h>
#include <zephyr/drivers/gpio.h>
#include <zephyr/device.h>
#include <zephyr/drivers/sensor.h>
#include "producer.h"

#define LM75_NODE DT_NODELABEL(temp_sensor)

static const struct device *const temp_dev = DEVICE_DT_GET(LM75_NODE);

void producerThread(void *inLed, void* inMsgQueue, void*) {
      struct gpio_dt_spec *toggleLED = (struct gpio_dt_spec*)inLed;
      struct k_msgq *notifyMsgQueue = (struct k_msgq*)inMsgQueue;
      bool led_state = true;
      int counter = 0;
      int32_t data = 0;

      if (!device_is_ready(temp_dev)) {
            printk("(producer) Temperature sensor %s is not ready\n", temp_dev->name);
            return;
      }

	while (1) {
            gpio_pin_toggle_dt(toggleLED);
            led_state = !led_state;
            if(counter++>=10) {
                  struct sensor_value temp_val;

                  if (sensor_sample_fetch(temp_dev) == 0 &&
                      sensor_channel_get(temp_dev, SENSOR_CHAN_AMBIENT_TEMP, &temp_val) == 0) {
                        /* Send the temperature in milli-degrees Celsius. */
                        data = (int32_t)sensor_value_to_milli(&temp_val);
                        k_msgq_put(notifyMsgQueue, &data, K_NO_WAIT);
                  } else {
                        printk("(producer) Failed to read temperature\n");
                  }
                  counter = 0;
            }

           k_msleep(SLEEP_TIME_MS);
	}
}
```
